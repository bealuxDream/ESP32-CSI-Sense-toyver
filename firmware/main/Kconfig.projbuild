## firmware/main/Kconfig.projbuild
```kconfig
menu "CSI Classroom Demo"
    config DEMO_WIFI_SSID
        string "2.4 GHz Wi-Fi SSID"
        default "YOUR_2G_WIFI"
        help
            Use a normal 2.4 GHz router with DHCP and ICMP ping replies.
    config DEMO_WIFI_PASSWORD
        string "Wi-Fi password (empty for an open network)"
        default ""
    config DEMO_PING_INTERVAL_MS
        int "Router ping interval (ms)"
        range 20 1000
        default 50
    config DEMO_OUTPUT_INTERVAL_MS
        int "Serial output interval (ms)"
        range 100 1000
        default 100
endmenu
```

## firmware/sdkconfig.defaults
```kconfig
CONFIG_ESP_WIFI_CSI_ENABLED=y
CONFIG_ESP_CONSOLE_UART_DEFAULT=y
CONFIG_ESP_CONSOLE_SECONDARY_USB_SERIAL_JTAG=y
CONFIG_ESP_CONSOLE_UART_BAUDRATE=115200
CONFIG_LOG_DEFAULT_LEVEL_INFO=y
CONFIG_LOG_COLORS=n
CONFIG_ESPTOOLPY_FLASHSIZE_2MB=y
CONFIG_FREERTOS_HZ=1000
```
